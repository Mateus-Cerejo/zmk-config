#include "boomerang.dtsi"
#include <dt-bindings/zmk/matrix_transform.h>

/ {
    chosen {
        zmk,kscan = &kscan0;
    };

    kscan0: kscan {
        compatible = "zmk,kscan-gpio-matrix";

        diode-direction = "row2col";

        row-gpios = <
            &gpio1 10 GPIO_ACTIVE_HIGH
            &gpio0 16 GPIO_ACTIVE_HIGH
            &gpio0 14 GPIO_ACTIVE_HIGH
            &gpio0 20 GPIO_ACTIVE_HIGH
            &gpio0 19 GPIO_ACTIVE_HIGH
            &gpio0 18 GPIO_ACTIVE_HIGH
        >;

        col-gpios = <
            &gpio0 9 GPIO_ACTIVE_HIGH
            &gpio0 8 GPIO_ACTIVE_HIGH
            &gpio0 7 GPIO_ACTIVE_HIGH
            &gpio0 6 GPIO_ACTIVE_HIGH
            &gpio0 5 GPIO_ACTIVE_HIGH
            &gpio0 4 GPIO_ACTIVE_HIGH
            &gpio0 3 GPIO_ACTIVE_HIGH
        >;
    };
};