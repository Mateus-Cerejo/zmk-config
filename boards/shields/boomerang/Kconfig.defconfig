## boards/shields/boomerang/Kconfig.defconfig
```kconfig
if SHIELD_BOOMERANG_LEFT

config ZMK_KEYBOARD_NAME
    default "Boomerang"

config ZMK_SPLIT_ROLE_CENTRAL
    default y

endif

if SHIELD_BOOMERANG_LEFT || SHIELD_BOOMERANG_RIGHT

config ZMK_SPLIT
    default y

endif
```

## boards/shields/boomerang_left/Kconfig.defconfig
```kconfig
if SHIELD_BOOMERANG_LEFT

config ZMK_KEYBOARD_NAME
  default "boomerang_left"

endif
```

## boards/shields/boomerang_left/Kconfig.shield
```kconfig
config SHIELD_BOOMERANG_LEFT
  def_bool $(shields_list_contains, boomerang_left)
```
